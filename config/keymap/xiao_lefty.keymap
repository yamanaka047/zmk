/ {
    keymap {
        compatible = "zmk,keymap";
        layout = [ 
            &kp Q &kp W &kp E &kp R &kp T
            &kp A &kp S &kp D &kp F &kp G
            &kp Z &kp X &kp C &kp V &kp B
            &kp 1 &kp 2 &kp 3 &kp 4 &kp 5
            &kp ESC &kp TAB &kp SPACE &kp ENTER &trans
        ];
    };
};
